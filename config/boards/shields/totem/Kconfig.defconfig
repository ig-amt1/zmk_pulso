## config/boards/shields/totem/Kconfig.defconfig
```kconfig
# Copyright (c) 2020 The ZMK Contributors
# SPDX-License-Identifier: MIT

if SHIELD_PULSO_DONGLE 

config ZMK_KEYBOARD_NAME
	default "pulso"

config ZMK_SPLIT_ROLE_CENTRAL
  default y

config ZMK_USB
	default y

endif

if ZMK_DISPLAY

config I2C
  default y

config SSD1306
  default y

config SSD1306_REVERSE_MODE
  default y

choice ZMK_DISPLAY_WORK_QUEUE
    default ZMK_DISPLAY_WORK_QUEUE_DEDICATED
endchoice

endif

if LVGL

config LV_Z_VDB_SIZE
  default 64

config LV_DPI_DEF
  default 148

config LV_Z_BITS_PER_PIXEL
  default 1

choice LV_COLOR_DEPTH
  default LV_COLOR_DEPTH_1
endchoice

endif

if SHIELD_PULSO_DONGLE || SHIELD_PULSO_LEFT || SHIELD_PULSO_RIGHT

config ZMK_SPLIT
  default y

endif
```
